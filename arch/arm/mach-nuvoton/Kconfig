## arch/arm/mach-nuvoton/Kconfig
```kconfig
if ARCH_NUVOTON

config SYS_SOC
	default "nuvoton"

config SYS_VENDOR
	default "nuvoton"

config MA35D1
	select ARM64
	select DM
	select DM_ETH
	bool "Nuvoton MA35D1"
	default n

source "arch/arm/mach-nuvoton/ma35d1/Kconfig"
source "board/nuvoton/ma35d1/Kconfig"

config MA35D0
	select ARM64
	select DM
	select DM_ETH
	bool "Nuvoton MA35D0"
	default n

source "arch/arm/mach-nuvoton/ma35d0/Kconfig"
source "board/nuvoton/ma35d0/Kconfig"

config MA35H0
	select ARM64
	select DM
	select DM_ETH
	bool "Nuvoton MA35H0"
	default n

source "arch/arm/mach-nuvoton/ma35h0/Kconfig"
source "board/nuvoton/ma35h0/Kconfig"

endif
```

## arch/arm/mach-nuvoton/ma35d0/Kconfig
```kconfig
if MA35D0

choice
	prompt  "Nuvoton MA35D0 board select"
	optional

config TARGET_MA35D0_EVB
	bool "MA35D0 EVB"

config TARGET_MA35D0_IOT
	bool "MA35D0 IoT Board"

endchoice

endif
```

## arch/arm/mach-nuvoton/ma35h0/Kconfig
```kconfig
if MA35H0

choice
	prompt  "Nuvoton MA35H0 board select"
	optional

config TARGET_MA35H0_EVB
	bool "MA35H0 EVB"

config TARGET_MA35H0_IOT
	bool "MA35H0 IoT Board"

endchoice

endif
```

## board/nuvoton/ma35d0/Kconfig
```kconfig
if MA35D0

config SYS_BOARD
	default "ma35d0"

config SYS_VENDOR
	default "nuvoton"

config SYS_CONFIG_NAME
	default "ma35d0"

endif
```

## board/nuvoton/ma35h0/Kconfig
```kconfig
if MA35H0

config SYS_BOARD
	default "ma35h0"

config SYS_VENDOR
	default "nuvoton"

config SYS_CONFIG_NAME
	default "ma35h0"

endif
```

## cmd/nuvoton/Kconfig
```kconfig
menu "Nuvoton specific command line interface"

config CMD_NU_AES
	bool "Enable the command for AES decrypt image"
	depends on MA35D1_CRYPTO || MA35D0_CRYPTO || MA35H0_CRYPTO
	help
	   Support decrypt the kernel image with Nuvoton
	   MA35D1 on-chip cryptographic accelerator. 

endmenu
```

## drivers/crypto/Kconfig
```kconfig
menu "Hardware crypto devices"

config MA35D1_CRYPTO
	bool "Nuvoton MA35D1 cryptographic accelerator."
	depends on MA35D1
	default y
	help
	  Enables support for the on-chip cryptographic accelerator on MA35D1.

config MA35D0_CRYPTO
	bool "Nuvoton MA35D0 cryptographic accelerator."
	depends on MA35D0
	default y
	help
	  Enables support for the on-chip cryptographic accelerator on MA35D0.

config MA35H0_CRYPTO
	bool "Nuvoton MA35H0 cryptographic accelerator."
	depends on MA35H0
	default y
	help
	  Enables support for the on-chip cryptographic accelerator on MA35H0.

source drivers/crypto/fsl/Kconfig

endmenu
```

## drivers/pinctrl/nuvoton/Kconfig
```kconfig
config PINCTRL_MA35D1
	bool "NUVOTON MA35D1 pin control drivers"
	depends on PINCTRL_GENERIC
	depends on MA35D1 
	default y
	help
	  Enable support pin control functions for NVT SoCs.

config SPL_PINCTRL_MA35D1
	bool "Support NUVOTON MA35D1 pin controllers in SPL"
	depends on SPL_PINCTRL_GENERIC 
	depends on MA35D1
	default y
	help
	  This option is an SPL-variant of the PINCTRL_NVT option.

config PINCTRL_MA35D0
	bool "NUVOTON MA35D0 pin control drivers"
	depends on PINCTRL_GENERIC
	depends on MA35D0
	default y
	help
	  Enable support pin control functions for NVT SoCs.

config SPL_PINCTRL_MA35D0
	bool "Support NUVOTON MA35D0 pin controllers in SPL"
	depends on SPL_PINCTRL_GENERIC
	depends on MA35D0
	default y
	help
	  This option is an SPL-variant of the PINCTRL_NVT option.
	  
config PINCTRL_MA35H0
	bool "NUVOTON MA35H0 pin control drivers"
	depends on PINCTRL_GENERIC
	depends on MA35H0
	default y
	help
	  Enable support pin control functions for NVT SoCs.

config SPL_PINCTRL_MA35H0
	bool "Support NUVOTON MA35H0 pin controllers in SPL"
	depends on SPL_PINCTRL_GENERIC
	depends on MA35H0
	default y
	help
	  This option is an SPL-variant of the PINCTRL_NVT option.
```
